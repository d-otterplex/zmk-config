## boards/arm/d12/Kconfig.board
```kconfig
# d12 board configuration

# Copyright (c) 2021 EmR
# SPDX-License-Identifier: MIT

config BOARD_D12_LEFT
	bool "d12 left"
	depends on SOC_PART_NUMBER_SAMD21E18A

config BOARD_D12_RIGHT
	bool "d12 right"
	depends on SOC_PART_NUMBER_SAMD21E18A
```

## boards/arm/d12/Kconfig.defconfig
```kconfig
if BOARD_D12_LEFT

config ZMK_KEYBOARD_NAME
    default "d12"

config ZMK_SPLIT_ROLE_CENTRAL
    default y

config ZMK_USB
    default y

endif


if BOARD_D12_LEFT || BOARD_D12_RIGHT

config ZMK_SPLIT
    default y

config ZMK_SPLIT_SERIAL
	default y

config SERIAL
    default y

config ZMK_KSCAN_DIRECT_POLLING
    default y

config UART_INTERRUPT_DRIVEN
    default y

config UART_LINE_CTRL
    default y
endif
```

## boards/arm/d12/d12_left_defconfig
```kconfig
# SPDX-License-Identifier: Apache-2.0

CONFIG_SOC_SERIES_SAMD21=y
CONFIG_SOC_PART_NUMBER_SAMD21E18A=y
CONFIG_BOARD_D12_LEFT=y
CONFIG_SOC_ATMEL_SAMD_OSC8M=y
CONFIG_SOC_ATMEL_SAMD_OSC8M_AS_MAIN=y
CONFIG_CORTEX_M_SYSTICK=y
CONFIG_PINCTRL=y
CONFIG_USE_DT_CODE_PARTITION=y
CONFIG_BOOTLOADER_BOSSA=y
CONFIG_BOOTLOADER_BOSSA_ADAFRUIT_UF2=y
CONFIG_BUILD_OUTPUT_UF2=y
CONFIG_SERIAL=y

# Turn on logging, and set ZMK logging to debug output
# CONFIG_ZMK_USB_LOGGING=y
# Delay logging process to catch issues that happen near keyboard boot
# CONFIG_LOG_PROCESS_THREAD_STARTUP_DELAY_MS=8000
```

## boards/shields/uniplus/Kconfig.defconfig
```kconfig
if SHIELD_UNIPLUS
      
config ZMK_KEYBOARD_NAME  
    default "uniplus"
config SPI
    default y

endif
```

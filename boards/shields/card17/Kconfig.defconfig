## boards/shields/card32/Kconfig.defconfig
```kconfig
if SHIELD_CARD32
      
config ZMK_KEYBOARD_NAME  
    default "card32"
config SPI
    default y

endif
```

## boards/shields/led595-bl/Kconfig.defconfig
```kconfig
if SHIELD_LED595_BL
      
config ZMK_KEYBOARD_NAME  
    default "led595-bl"
config SPI
    default y

config ZMK_BACKLIGHT
    select LED
    select LED_GPIO

endif
```

## boards/shields/led595/Kconfig.defconfig
```kconfig
if SHIELD_LED595
      
config ZMK_KEYBOARD_NAME  
    default "led595"
config SPI
    default y

# config ZMK_BACKLIGHT
# select LED
# select LED_GPIO

endif
```
